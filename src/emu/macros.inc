;;;---------------------------------------------------------------------------
;;; function for label to address for FIM&FIN
;;;---------------------------------------------------------------------------

lo	function x, ((x)&255)
up	function x, (((x)>>8)&255)

;;;---------------------------------------------------------------------------
;;; functuon for setting counter for ISZ loop
;;;---------------------------------------------------------------------------

loop	function x, (16-(x))
loops	function x,y, ((16-(x))<<4 + (16-(y)))

;;;---------------------------------------------------------------------------
;;; Alias for Registers and Register Pairs
;;;---------------------------------------------------------------------------

;;; Registers
R10	reg RA
R11	reg RB
R12	reg RC
R13	reg RD
R14	reg RE
R15	reg RF

;;; Register Pairs
P0	reg R0R1
P1	reg R2R3
P2	reg R4R5
P3	reg R6R7
P4	reg R8R9
P5	reg RARB
P6	reg RCRD
P7	reg RERF
R10R11	reg RARB
R12R13	reg RCRD
R14R15	reg RERF

;;; Register Pairs
P0_HI	reg R0
P0_LO	reg R1
P1_HI	reg R2
P1_LO	reg R3
P2_HI	reg R4
P2_LO	reg R5
P3_HI	reg R6
P3_LO	reg R7
P4_HI	reg R8
P4_LO	reg R9
P5_HI	reg R10
P5_LO	reg R11
P6_HI	reg R12
P6_LO	reg R13
P7_HI	reg R14
P7_LO	reg R15

;;;---------------------------------------------------------------------------
;;; Register Pair used as a Stack Pointer
;;;---------------------------------------------------------------------------
SP	reg P4
SP_HI	reg R8
SP_LO	reg R9

;;;---------------------------------------------------------------------------
;;; Register Pair used as a Stack Pointer
;;;---------------------------------------------------------------------------
CNT	reg P5
CNT_I	reg R10
CNT_J	reg R11
CNT_HI	reg R10
CNT_LO	reg R11

;;;---------------------------------------------------------------------------
;;; macro instructions
;;;---------------------------------------------------------------------------

;;;----------------------------------------------------------------------------
;;; LD_REG4P7_ACC
;;; REG4(P7)=ACC
;;;----------------------------------------------------------------------------
LD_REG4P7_ACC macro
	SRC P7
	WRM
	endm

;;;----------------------------------------------------------------------------
;;; LD_ACC_REG4P7
;;; REG4(P7)=ACC
;;;----------------------------------------------------------------------------
LD_ACC_REG4P7 macro
	SRC P7
	RDM
	endm

;;;----------------------------------------------------------------------------
;;; Register Pair Operations
;;;----------------------------------------------------------------------------
LD_P0_P1	macro	; P0 = P1
		LD P1_HI
		XCH P0_HI
		LD P1_LO
		XCH P0_LO
		endm
;;;----------------------------------------------------------------------------
LD_P0_P3	macro	; P0 = P3
		LD P3_HI
		XCH P0_HI
		LD P3_LO
		XCH P0_LO
		endm
;;;----------------------------------------------------------------------------
LD_P1_P0	macro	; P1 = P0
		LD P0_HI
		XCH P1_HI
		LD P0_LO
		XCH P1_LO
		endm
;;;----------------------------------------------------------------------------
LD_P1_P2	macro	; P1 = P2
		LD P2_HI
		XCH P1_HI
		LD P2_LO
		XCH P1_LO
		endm
;;;----------------------------------------------------------------------------
LD_P1_P3	macro	; P1 = P3
		LD P3_HI
		XCH P1_HI
		LD P3_LO
		XCH P1_LO
		endm
;;;----------------------------------------------------------------------------
LD_P2_P1	macro	; P2 = P1
		LD P1_HI
		XCH P2_HI
		LD P1_LO
		XCH P2_LO
		endm
;;;----------------------------------------------------------------------------
LD_P2_P3	macro	; P2 = P3
		LD P3_HI
		XCH P2_HI
		LD P3_LO
		XCH P2_LO
		endm
;;;----------------------------------------------------------------------------
LD_P3_P0	macro	; P3 = P0
		LD P0_HI
		XCH P3_HI
		LD P0_LO
		XCH P3_LO
		endm
;;;----------------------------------------------------------------------------
LD_P3_P1	macro	; P3 = P1
		LD P1_HI
		XCH P3_HI
		LD P1_LO
		XCH P3_LO
		endm
;;;----------------------------------------------------------------------------
LD_P3_P2	macro	; P3 = P2
		LD P2_HI
		XCH P3_HI
		LD P2_LO
		XCH P3_LO
		endm
;;;----------------------------------------------------------------------------
LD_P6_P0	macro	; P6 = P0
		LD P0_HI
		XCH P6_HI
		LD P0_LO
		XCH P6_LO
		endm
;;;----------------------------------------------------------------------------
LD_P6_P1	macro	; P6 = P1
		LD P1_HI
		XCH P6_HI
		LD P1_LO
		XCH P6_LO
		endm
;;;----------------------------------------------------------------------------
LD_P6_SP	macro	; P6 = SP
		LD SP_HI
		XCH P6_HI
		LD SP_LO
		XCH P6_LO
		endm
;;;----------------------------------------------------------------------------
LD_P7_P0	macro	; P7 = P0
		LD P0_HI
		XCH P7_HI
		LD P0_LO
		XCH P7_LO
		endm
;;;----------------------------------------------------------------------------
LD_P7_P1	macro	; P7 = P1
		LD P1_HI
		XCH P7_HI
		LD P1_LO
		XCH P7_LO
		endm
;;;----------------------------------------------------------------------------
LD_P7_P2	macro	; P7 = P2
		LD P2_HI
		XCH P7_HI
		LD P2_LO
		XCH P7_LO
		endm
;;;----------------------------------------------------------------------------
LD_P7_P3	macro	; P7 = P3
		LD P3_HI
		XCH P7_HI
		LD P3_LO
		XCH P7_LO
		endm
;;;----------------------------------------------------------------------------
LD_CNT_P1	macro	; CNT = P1
		LD P1_HI
		XCH CNT_HI
		LD P1_LO
		XCH CNT_LO
		endm
;;;----------------------------------------------------------------------------
LD_P1_CNT	macro	; P1 = CNT
		LD CNT_HI
		XCH P1_HI
		LD CNT_LO
		XCH P1_LO
		endm
;;;----------------------------------------------------------------------------

;;;----------------------------------------------------------------------------
;;; For debug
;;;----------------------------------------------------------------------------
;;;----------------------------------------------------------------------------
;;; DEBUG_SAFEPUTCHAR
;;; PUTCHAR that does not destroy P1
;;;----------------------------------------------------------------------------
DEBUG_SAFEPUTCHAR	macro ch
	JMS PUSH_P1
	FIM P1, ch
	JMS PUTCHAR_P1
	JMS POP_P1
	endm
